## mysis-esp32/sdkconfig.defaults
```kconfig
# 公共配置（所有芯片共享）

# MQTT
CONFIG_MQTT_TRANSPORT_SSL=n

# 日志级别
CONFIG_LOG_DEFAULT_LEVEL_INFO=y
```

## mysis-esp32/sdkconfig.defaults.esp32c3
```kconfig
# ESP32-C3 专属配置
CONFIG_IDF_TARGET="esp32c3"

# 无 PSRAM，缩小栈
CONFIG_ESP_MAIN_TASK_STACK_SIZE=16384
```

## mysis-esp32/sdkconfig.defaults.esp32s3
```kconfig
# ESP32-S3 专属配置
CONFIG_IDF_TARGET="esp32s3"

# PSRAM 启用
CONFIG_SPIRAM=y
CONFIG_SPIRAM_USE_MALLOC=y
CONFIG_SPIRAM_MALLOC_ALWAYSINTERNAL=4096

# 栈大小（PSRAM 充足，可用较大栈）
CONFIG_ESP_MAIN_TASK_STACK_SIZE=32768
```
